// oled_task: จอ SSD1306 128x64 (driver เขียนเอง ไม่ใช้ไลบรารี เหมือน BenchTest)
//   หน้าเดียวตลอด: บรรทัดบนตัวใหญ่ = สถานะคนขับ · 5 บรรทัดล่าง = ตา / เสียง / ชื่อ AP / URL ผ่าน AP / URL ผ่าน WiFi
//   สถานะ: WAKE UP! > SLEEPY > LOOK AHEAD (3 อย่างนี้กลับสีแถบบน) > UNCLEAR > NO DRIVER > AWAKE
//   ไม่กะพริบ · หรี่จอเมื่อมืด (เกณฑ์ LDR เดียวกับ IR) · ค่าดีบักอื่น (P ตาปิด, fps, Sync) ดูที่หน้าเว็บของ Device
// อยู่ Core 0 priority ต่ำ: I2C ส่งทั้งจอ ~25 ms ไม่แย่งเวลา vision
#include <Wire.h>
#include "../core/config.h"
#include "../core/shared_state.h"
#include "../core/tasks.h"

static const uint8_t FONT5X7[95][5] = {   // ASCII 0x20..0x7E · คอลัมน์ละไบต์ บิต 0 = บนสุด
  {0x00,0x00,0x00,0x00,0x00},{0x00,0x00,0x5F,0x00,0x00},{0x00,0x07,0x00,0x07,0x00},{0x14,0x7F,0x14,0x7F,0x14},
  {0x24,0x2A,0x7F,0x2A,0x12},{0x23,0x13,0x08,0x64,0x62},{0x36,0x49,0x55,0x22,0x50},{0x00,0x05,0x03,0x00,0x00},
  {0x00,0x1C,0x22,0x41,0x00},{0x00,0x41,0x22,0x1C,0x00},{0x08,0x2A,0x1C,0x2A,0x08},{0x08,0x08,0x3E,0x08,0x08},
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  {0x00,0x00,0x7F,0x00,0x00},{0x00,0x41,0x36,0x08,0x00},{0x08,0x04,0x08,0x10,0x08},
};

static uint8_t s_addr = 0;
static uint8_t s_fb[8][128];   // 8 page x 128 คอลัมน์ · บิต 0 ของแต่ละไบต์ = แถวบนสุดของ page

static void cmd(uint8_t c) {
  Wire.beginTransmission(s_addr); Wire.write(0x00); Wire.write(c); Wire.endTransmission();
}

static bool probe() {
  for (uint8_t a : {(uint8_t)0x3C, (uint8_t)0x3D}) {
    Wire.beginTransmission(a);
    if (Wire.endTransmission() == 0) { s_addr = a; return true; }
  }
  s_addr = 0;
  return false;
}

static void initDisplay() {
  // ชุดเดียวกับ BenchTest ที่ทดสอบผ่านบนบอร์ด v2 (23 ต.ค.)
  const uint8_t init[] = {0xAE, 0xD5, 0x80, 0xA8, 0x3F, 0xD3, 0x00, 0x40, 0x8D, 0x14,
                          0x20, 0x00, 0xA1, 0xC8, 0xDA, 0x12, 0x81, 0xCF, 0xD9, 0xF1,
                          0xDB, 0x40, 0xA4, 0xA6, 0xAF};
  for (uint8_t c : init) cmd(c);
}

// ส่งทั้งจอ · คืน false ถ้า I2C ล้ม (จอหลุด)
static bool flush() {
  cmd(0x21); cmd(0); cmd(127);   // column 0-127
  cmd(0x22); cmd(0); cmd(7);     // page 0-7
  for (int p = 0; p < 8; p++) {
    for (int c = 0; c < 128; c += 32) {
      Wire.beginTransmission(s_addr);
      Wire.write(0x40);
      Wire.write(&s_fb[p][c], 32);
      if (Wire.endTransmission() != 0) return false;
    }
  }
  return true;
}

static const uint8_t* glyph(char ch) {
  if (ch < 0x20 || ch > 0x7E) ch = '?';
  return FONT5X7[ch - 0x20];
}

static void pixel(int x, int y) {
  if (x >= 0 && x < 128 && y >= 0 && y < 64) s_fb[y >> 3][x] |= 1 << (y & 7);
}

// ตัว 5x7 ขยาย scale เท่า มุมซ้ายบนที่ (x, y) · ช่องไฟ 1 คอลัมน์ (x scale) ระหว่างตัว
static void textScaled(int x, int y, const char* s, int scale) {
  for (; *s; s++, x += 6 * scale) {
    const uint8_t* g = glyph(*s);
    for (int i = 0; i < 5; i++)
      for (int b = 0; b < 7; b++)
        if (g[i] & (1 << b))
          for (int dx = 0; dx < scale; dx++)
            for (int dy = 0; dy < scale; dy++) pixel(x + i * scale + dx, y + b * scale + dy);
  }
}

static int textWidth(const char* s, int scale) {
  int n = strlen(s);
  return n ? (6 * n - 1) * scale : 0;
}

// หน้าข้อมูล: แถบบน (page 0-1) ตัว x2 ไม่เกิน 10 ตัว · 5 บรรทัดล่างตัว x1 ไม่เกิน 21 ตัว
struct InfoScreen {
  char status[11];
  bool alert;          // true = กลับสีแถบบน
  char line[5][22];
};

static void drawInfo(const InfoScreen& sc) {
  textScaled((128 - textWidth(sc.status, 2)) / 2, 1, sc.status, 2);
  if (sc.alert)
    for (int p = 0; p < 2; p++)
      for (int c = 0; c < 128; c++) s_fb[p][c] ^= 0xFF;
  for (int i = 0; i < 5; i++) textScaled(0, 18 + i * 9, sc.line[i], 1);
}

// ทดสอบจากหน้าเว็บ: สลับทั้งจอขาว / ตาราง ให้เห็นว่าทุกพิกเซลติดและขอบครบ
static void renderTest(uint32_t now) {
  bool white = (now / 500) % 2 == 0;
  for (int p = 0; p < 8; p++)
    for (int c = 0; c < 128; c++) s_fb[p][c] = white ? 0xFF : ((c & 1) ? 0xAA : 0x55);
}

// เลือกสถานะและบรรทัดข้อมูลจาก state ล้วน (ไม่จำอะไรข้ามเฟรม)
static void pickInfo(const SharedState& s, uint32_t now, InfoScreen& sc) {
  const char* st = "AWAKE";
  sc.alert = false;
  if (s.level == DrowsinessLevel::Microsleep)      { st = "WAKE UP!";   sc.alert = true; }
  else if (s.level == DrowsinessLevel::Drowsy)     { st = "SLEEPY";     sc.alert = true; }
  else if (s.distraction)                          { st = "LOOK AHEAD"; sc.alert = true; }
  else if (s.unmonitored)                          st = "UNCLEAR";
  else if (!s.driverPresent)                       st = "NO DRIVER";
  strlcpy(sc.status, st, sizeof(sc.status));

  char* l = sc.line[0];
  if (!s.faceFound)                           strlcpy(l, "EYE: NO FACE", 22);
  else if (s.eyeState == EyeState::Open)      strlcpy(l, "EYE: OPEN", 22);
  else if (s.eyeState == EyeState::Closed)    snprintf(l, 22, "EYE: CLOSED %.1fs", s.closedMs / 1000.0f);
  else if (s.eyeState == EyeState::Uncertain) strlcpy(l, "EYE: UNSURE", 22);
  else                                        strlcpy(l, "EYE: NOT FOUND", 22);

  // เสียง: กฎเดียวกับ buzzer ใน alert.cpp · ระดับ 3 ดังแม้ปิดเสียงอยู่
  int32_t muteLeft = s.mutedUntilMs ? (int32_t)(s.mutedUntilMs - now) : 0;
  bool testing = s.hwTest == HwTest::Buzzer && s.hwTestUntilMs && (int32_t)(s.hwTestUntilMs - now) > 0;
  l = sc.line[1];
  if (s.level == DrowsinessLevel::Microsleep) strlcpy(l, "SOUND: ALARM", 22);
  else if (testing)                           strlcpy(l, "SOUND: TEST", 22);
  else if (muteLeft > 0)
    snprintf(l, 22, "SOUND: MUTED %lu:%02lu", (unsigned long)(muteLeft / 60000), (unsigned long)(muteLeft / 1000 % 60));
  else if (s.level == DrowsinessLevel::Drowsy || s.distraction) strlcpy(l, "SOUND: BEEPING", 22);
  else                                        strlcpy(l, "SOUND: ON", 22);

  snprintf(sc.line[2], 22, "AP  %.17s", s.apSsid);
  strlcpy(sc.line[3], "URL 192.168.4.1", 22);   // IP ของ softAP ค่าเริ่มต้น (net.cpp ไม่ได้ตั้งเอง)
  if (s.staConnected)       snprintf(sc.line[4], 22, "LAN %.17s", s.staIp);
  else if (s.staTrying[0])  snprintf(sc.line[4], 22, "LAN try %.13s", s.staTrying);
  else if (!s.staTried)     strlcpy(sc.line[4], "LAN starting", 22);
  else                      strlcpy(sc.line[4], "LAN no wifi", 22);
}

static void oledTask(void*) {
  Wire.begin(PIN_OLED_SDA, PIN_OLED_SCL);
  Wire.setClock(400000);
  bool ok = false;
  bool dark = false;
  int contrast = -1;
  for (;;) {
    uint32_t now = millis();
    if (!ok) {
      ok = probe();
      if (ok) { initDisplay(); contrast = -1; Serial.printf("[oled] SSD1306 at 0x%02X\n", s_addr); }
      { StateGuard g; g_state.oledOk = ok; }
      if (!ok) { vTaskDelay(pdMS_TO_TICKS(OLED_RETRY_MS)); continue; }
    }
    SharedState s = stateSnapshot();

    if (!dark && s.ldrRaw >= LDR_DARK_ON_RAW)  dark = true;
    if (dark  && s.ldrRaw <= LDR_DARK_OFF_RAW) dark = false;
    int want = dark ? OLED_CONTRAST_DARK : OLED_CONTRAST_DAY;
    if (want != contrast) { cmd(0x81); cmd(want); contrast = want; }

    InfoScreen sc;
    pickInfo(s, now, sc);
    memset(s_fb, 0, sizeof(s_fb));
    if (s.hwTest == HwTest::Oled && s.hwTestUntilMs && (int32_t)(s.hwTestUntilMs - now) > 0) renderTest(now);
    else drawInfo(sc);
    if (!flush()) {
      ok = false;
      StateGuard g; g_state.oledOk = false;
    }
    vTaskDelay(pdMS_TO_TICKS(OLED_PERIOD_MS));
  }
}

void startOledTask() {
  xTaskCreatePinnedToCore(oledTask, "oled", 4096, nullptr, 1, nullptr, CORE_NET);
}
